#include "goose.dtsi"

&default_transform {
  col-offset = <5>;
};

&kscan0 {
  col-gpios
      = <&xiao_d 4 GPIO_ACTIVE_HIGH>
      , <&xiao_d 3 GPIO_ACTIVE_HIGH>
      , <&xiao_d 2 GPIO_ACTIVE_HIGH>
      , <&xiao_d 1 GPIO_ACTIVE_HIGH>
      , <&xiao_d 0 GPIO_ACTIVE_HIGH>
      ;
};

&right_encoder {
    status = "okay";
};
