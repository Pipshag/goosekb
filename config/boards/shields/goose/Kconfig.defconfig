## config/boards/shields/goose/Kconfig.defconfig
```kconfig
if SHIELD_GOOSE_LEFT

config ZMK_KEYBOARD_NAME
    default "Cherry Goose" 
config USB_DEVICE_MANUFACTURER
    default "Pipshag"
config ZMK_SPLIT_ROLE_CENTRAL
    default y

endif

if SHIELD_GOOSE_LEFT || SHIELD_GOOSE_RIGHT

config ZMK_SPLIT
    default y

endif
```

## config/boards/shields/goose/Kconfig.shield
```kconfig
config SHIELD_GOOSE_LEFT
    def_bool $(shields_list_contains,goose_left)

config SHIELD_GOOSE_RIGHT
    def_bool $(shields_list_contains,goose_right)
```
